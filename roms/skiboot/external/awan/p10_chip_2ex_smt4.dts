/dts-v1/;

/ {
	compatible = "ibm,powernv";
	model = "BML";
	#size-cells = <0x2>;
	#address-cells = <0x2>;

	reserved-names = "ibm,fake-nvram";
	reserved-ranges = <0x0 0x28100000 0x0 0x100000>;

	chosen {
		kernel-base-address = <0x00 0x00>;
		linux,initrd-start = <0x28200000>;
		linux,initrd-end = <0x28200800>;
	};

	awan {
		device_type = "chip";
	};

	memory@0 {
		reg = <0x0 0x0 0x0 0x80000000>;
		ibm,chip-id = <0x0>;
		device_type = "memory";
	};

	cpus {
		#address-cells = <0x01>;
		#size-cells = <0x00>;

		PowerPC,POWER10@18 {
			name = "PowerPC,POWER10";
			device_type = "cpu";
			status = "okay";
			ibm,chip-id = <0x00>;
			ibm,pir = <0x18>;
			reg = <0x18>;
			timebase-frequency = <512000000>;
			clock-frequency = <3250000000>;
			ibm,segment-page-sizes = <0x0c 0x00 0x3 0xc 0x0 0x10 0x7 0x18 0x38 0x10 0x110 0x2 0x10 0x1 0x18 0x08 0x18 0x100 0x1 0x18 0x00 0x22 0x120 0x1 0x22 0x03>;
			ibm,processor-segment-sizes = <0x0000001c 0x28 0xffffffff 0xffffffff>;
			ibm,vmx = <0x2>;
			i-cache-size = <0x8000>;
			d-cache-size = <0x8000>;
			i-cache-line-size = <0x80>;
			d-cache-line-size = <0x80>;
			ibm,slb-size = <0x20>;
			ibm,ppc-interrupt-server#s = <0x18 0x19 0x1a 0x1b>;
			ibm,pa-features = <0x4000f63f 0xc7c080d0 0x80000000 0x00000000 0x00008000 0x80008000 0x00008000 0x80008000 0x00008000 0x80000000 0x80008000 0x80008000 0x80008000 0x80008000 0x80008000 0x80000000 0x80000000 0x00000000>;
			ibm,processor-radix-AP-encodings = <0x0000000c 0xa0000010 0x20000015 0x4000001e>;
			ibm,dfp = <0x2>;
		};

		PowerPC,POWER10@1c {
			name = "PowerPC,POWER10";
			device_type = "cpu";
			status = "okay";
			ibm,chip-id = <0x00>;
			ibm,pir = <0x1c>;
			reg = <0x1c>;
			timebase-frequency = <512000000>;
			clock-frequency = <3250000000>;
			ibm,segment-page-sizes = <0x0c 0x00 0x3 0xc 0x0 0x10 0x7 0x18 0x38 0x10 0x110 0x2 0x10 0x1 0x18 0x08 0x18 0x100 0x1 0x18 0x00 0x22 0x120 0x1 0x22 0x03>;
			ibm,processor-segment-sizes = <0x0000001c 0x28 0xffffffff 0xffffffff>;
			ibm,vmx = <0x2>;
			i-cache-size = <0x8000>;
			d-cache-size = <0x8000>;
			i-cache-line-size = <0x80>;
			d-cache-line-size = <0x80>;
			ibm,slb-size = <0x20>;
			ibm,ppc-interrupt-server#s = <0x1c 0x1d 0x1e 0x1f>;
			ibm,pa-features = <0x4000f63f 0xc7c080d0 0x80000000 0x00000000 0x00008000 0x80008000 0x00008000 0x80008000 0x00008000 0x80000000 0x80008000 0x80008000 0x80008000 0x80008000 0x80008000 0x80000000 0x80000000 0x00000000>;
			ibm,processor-radix-AP-encodings = <0x0000000c 0xa0000010 0x20000015 0x4000001e>;
			ibm,dfp = <0x2>;
		};
	};

	xscom@e03fc00000000 {
		compatible = "ibm,xscom", "ibm,power10-xscom";
		ibm,chip-id = <0x0>;
		#size-cells = <1>;
		#address-cells = <1>;
		reg = <0xe03fc 0x00000000 0x8 0x0>;

		ibm,primary-topology-index = <0x0>;

		chiptod@40000 {
			primary;
			reg = <0x40000 0x34>;
			compatible = "ibm,power-chiptod", "ibm,power10-chiptod";
		};

		xive@2010800 {
			compatible = "ibm,power10-xive-x";
			reg = < 0x2010800 0x400 >;
			force-assign-bars;
		};

		psihb@3011d00 {
			compatible = "ibm,power10-psihb-x", ibm,psihb-x";
			#size-cells = < 0x01 >;
			#address-cells = < 0x02 >;
			reg = < 0x3011d00 0x100 >;
		};

		nx@2010000 {
			reg = <0x2010000 0x4000>;
			compatible = "ibm,power9-nx";
		};

		vas@2011400 {
			reg = <0x2011400 0x300>;
			compatible = "ibm,power9-vas-x", "ibm,power10-vas-x";
			ibm,vas-id = < 0x0 >;
		};

		nmmu@2010c40 {
			reg = <0x2010c40 0x20>;
			compatible = "ibm,power9-nest-mmu";
		};

		nmmu@3010c40 {
			reg = <0x3010c40 0x20>;
			compatible = "ibm,power9-nest-mmu";
		};
	};

        ibm,opal {
                power-mgt {
                        ibm,enabled-stop-levels = <0x0>;
                };
        };

};
